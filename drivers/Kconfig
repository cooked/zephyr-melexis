## drivers/mlx90393/Kconfig
```kconfig
# MLX90393 IMU configuration options

menuconfig MLX90393
	bool "Enable support for MLX90393 3-axis magnetometer + temperature sensor"
	# This doesnt work
	# depends on (I2C && HAS_DTS_I2C)
	# But this does
	depends on (I2C)
	# select SENSOR_COMMON
	help
		Enable I2C-based driver for MLX90393 3-axis IMU magnetometer

if MLX90393

config MLX90393_INTERRUPT
	bool "Enable or disable interrupt-based mode"
	default false
	depends on (MLX90393)
	help
		Enables the use of the INT-pin on the MLX90393, also in code

	# Add log level for mlx90393 code
	module = MLX90393
	module-str = mlx90393
	source "subsys/logging/Kconfig.template.log_config"

endif
```

## drivers/mlx90393/dts/bindings/melexis,mlx90393-i2c.yaml
```yaml
description: |
  DeviceTree binding for the Melexis MLX90393 3-axis magnetometer IMU with
  temperature sensor.
compatible: "melexis,mlx90393"
on-bus: i2c
include: i2c-device.yaml

# TODO: Add (more) actual properties for the magnetomer here...
properties:
  interrupt-gpios:
    type: phandle-array
    required: false
    description: |
      The INT signal default configuration is active-high. The property value
      should ensure that the flags properly describe the signal that is
      presented to the driver.
  trigger-gpios:
    type: phandle-array
    required: false
    description: |
      The TRIG signal default configuration is active-high. The property value
      should ensure that the flags properly describe the signal that is
      presented to the driver.
```

## drivers/sensor/mlx90393/Kconfig
```kconfig
menuconfig MLX90393
	bool "MLX90393 I2C/SPI 3-axis magnetometer and temperature chip"
	default y
	depends on DT_HAS_MELEXIS_MLX90393_ENABLED
	select I2C if $(dt_compat_on_bus,$(DT_COMPAT_MELEXIS_MLX90393),i2c)
	select MLX90393_I2C if $(dt_compat_on_bus,$(DT_COMPAT_MELEXIS_MLX90393),i2c)
	select SPI if $(dt_compat_on_bus,$(DT_COMPAT_MELEXIS_MLX90393),spi)
	select MLX90393_SPI if $(dt_compat_on_bus,$(DT_COMPAT_MELEXIS_MLX90393),spi)
	help
		Enable driver for MLX90393 3-axis magnetometer

if MLX90393

config MLX90393_SPI
	bool "Use SPI bus"
	default n
	depends on (MLX90393 && SPI)
	help
		Enables SPI communication

config MLX90393_I2C
	bool "Use I2C bus"
	default n
	depends on (MLX90393 && I2C)
	help
		Enables I2C communication

config MLX90393_INTERRUPT
	bool "Enable or disable interrupt-based mode"
	default n
	depends on MLX90393
	help
		Enables the use of the INT-pin on the MLX90393, also in code

	# Add log level for mlx90393 code
	module = MLX90393
	module-str = mlx90393
	source "subsys/logging/Kconfig.template.log_config"

endif
```

## drivers/sensor/mlx90395/Kconfig
```kconfig
menuconfig MLX90395
	bool "MLX90395 I2C/SPI 3-axis magnetometer and temperature chip"
	default y
	depends on DT_HAS_MELEXIS_MLX90395_ENABLED
	select I2C if $(dt_compat_on_bus,$(DT_COMPAT_MELEXIS_MLX90395),i2c)
	select SPI if $(dt_compat_on_bus,$(DT_COMPAT_MELEXIS_MLX90395),spi)
	help
		Enable driver for MLX90393 3-axis magnetometer

if MLX90395

config MLX90395_INTERRUPT
	bool "Enable or disable interrupt-based mode"
	default n
	depends on MLX90395
	help
		Enables the use of the INT-pin on the MLX90395, also in code

	# Add log level for mlx90393 code
	module = MLX90395
	module-str = mlx90395
	source "subsys/logging/Kconfig.template.log_config"

endif
```

## dts/bindings/melexis,mlx-common.yaml
```yaml
properties:
  interrupt-gpios:
    type: phandle-array
    required: false
    description: |
      The INT signal default configuration is active-high. The property value
      should ensure that the flags properly describe the signal that is
      presented to the driver.
  trigger-gpios:
    type: phandle-array
    required: false
    description: |
      The TRIG signal default configuration is active-high. The property value
      should ensure that the flags properly describe the signal that is
      presented to the driver.

# TODO: Add (more) actual properties for the magnetomer here...
```

## dts/bindings/melexis,mlx90393-i2c.yaml
```yaml
description: |
  DeviceTree binding for the Melexis MLX90393 3-axis magnetometer IMU with
  temperature sensor.
compatible: "melexis,mlx90393"
on-bus: i2c
include: ["i2c-device.yaml", "melexis,mlx-common.yaml"]
```

## dts/bindings/melexis,mlx90393-spi.yaml
```yaml
description: |
  DeviceTree binding for the Melexis MLX90393 3-axis magnetometer IMU with
  temperature sensor.

compatible: "melexis,mlx90393"

include: ["spi-device.yaml", "melexis,mlx-common.yaml"]
```

## dts/bindings/melexis,mlx90395-spi.yaml
```yaml
description: |
  DeviceTree binding for the Melexis MLX90395 3-axis magnetometer IMU with
  temperature sensor.

compatible: "melexis,mlx90395"

include: ["spi-device.yaml", "melexis,mlx-common.yaml"]
```
